#ifndef STRRES_H
#define STRRES_H

#include <stdarg.h>
#include <stdbool.h>
#include <stddef.h>
#include <stdint.h>

#include "esp_err.h"

#ifdef __cplusplus
extern "C" {
#endif

/*
 * User-visible text, kept on a filesystem rather than in the image.
 *
 * A string compiled into the firmware occupies the OTA slot -- the scarce
 * resource on a 4 MB part -- and is duplicated across both slots. The same
 * string on the `res` partition costs one copy of a partition OTA does not
 * touch. Moving the application's prose there is worth tens of kilobytes of
 * slot headroom, and makes a second language a file rather than a rebuild.
 *
 * Strings are authored as JSON, one file per section, and compiled to .sr blobs
 * by tool/strres_compile.py. That step also emits the ids C refers to them by,
 * so a call site names a string readably and pays two bytes for it:
 *
 *     STRRES_PRINTF(STR_I2C_NO_BUS);
 *     STRRES_PRINTF(STR_I2C_RESPONDING, count, count == 1 ? "" : "s");
 *
 * This component formats no prose of its own. It carries the application's, the
 * way `diag` carries the application's output.
 *
 * ---------------------------------------------------------------------------
 * Buffer ownership, which is the whole of it: strres never returns a pointer
 * the caller must free.
 *
 *   - strres_printf() / strres_error() hand out nothing at all. The text does
 *     not cross the boundary, so there is nothing to own. Use these unless a
 *     string is genuinely needed as a value.
 *   - strres_copy() writes into memory the caller already owns.
 *   - strres_hold() lends a pointer into the cache and pins the section it
 *     lives in so it cannot be evicted. Every hold needs exactly one release,
 *     and that is the only pairing in this API.
 * ---------------------------------------------------------------------------
 */

/*
 * Distinct from the other components in this repository so that
 * esp_err_to_name() cannot attribute one subsystem's failure to another.
 * config_store uses 0x3D000, sht4x 0x32000.
 */
#define ESP_ERR_STRRES_BASE 0x3E000

/* The catalogue on disk was built for a different set of ids than the firmware
 * expects. Every lookup will miss; the resources need reflashing. */
#define ESP_ERR_STRRES_CATALOG_SKEW (ESP_ERR_STRRES_BASE + 1)

/* A .sr file was present but is not one, or is truncated. */
#define ESP_ERR_STRRES_BAD_SECTION  (ESP_ERR_STRRES_BASE + 2)

/*
 * A string id. Six bits of section and ten of index, so the section selects a
 * file and the index is a direct offset-table slot -- no search and no key
 * strings in the image.
 *
 * Id 0 is reserved and never valid, which lets a zero-initialised struct field
 * mean "no string set".
 */
typedef uint16_t strres_id_t;

#define STRRES_ID_NONE ((strres_id_t)0)

/* Generated by strres_compile.py; see strres_generated_catalog. */
typedef struct {
    uint32_t hash;                  /* must match every .sr on disk */
    uint16_t section_count;
    const char *const *section_names;
} strres_catalog_t;

typedef struct {
    /* Directory holding one subdirectory per locale. NULL for "/res/str". */
    const char *base_dir;
    /* NULL for CONFIG_STRRES_DEFAULT_LOCALE. */
    const char *locale;
} strres_config_t;

/*
 * Load the pinned section and check the catalogue against what is on disk.
 *
 * The filesystem must already be mounted -- this component takes paths and uses
 * stdio, so the application chooses and mounts the filesystem, and the reader
 * can be tested on the host against real files.
 *
 * `cfg` may be NULL for defaults. Returns ESP_ERR_STRRES_CATALOG_SKEW if the
 * resources on disk were built for different ids, in which case lookups still
 * work but every one of them misses -- deliberately, because printing
 * "[str:04F2]" is better than printing a sentence that means something else.
 */
esp_err_t strres_init(const strres_config_t *cfg, const strres_catalog_t *catalog);

/* Switch language. Drops every cached section, so it is not free; call it when
 * the configuration changes, not per string. */
esp_err_t strres_set_locale(const char *locale);

/* The locale in use, for reporting. Never NULL after a successful init. */
const char *strres_locale(void);

/* The catalogue hash the firmware was built against, for `sys info` -- so a
 * device whose resources are a build behind can be spotted in the field. */
uint32_t strres_catalog_hash(void);

/*
 * Print a string, with printf semantics.
 *
 * Prefer the STRRES_PRINTF/STRRES_ERROR macros below, which additionally check
 * the arguments at compile time. These take the format from the catalogue, so
 * the compiler cannot see it and cannot check anything.
 *
 * On a miss, prints "[str:XXXX]" naming the id and drops the arguments.
 */
void strres_printf(strres_id_t id, ...);
void strres_error(strres_id_t id, ...);
void strres_vprintf(strres_id_t id, va_list args);

/*
 * Copy a string into a caller-owned buffer.
 *
 * Returns the length excluding the terminator, or -1 on a miss. A return of
 * `buflen` or more means the text was truncated -- the buffer still holds a
 * valid NUL-terminated prefix. Nothing is allocated that outlives the call.
 */
int strres_copy(strres_id_t id, char *buf, size_t buflen);

/*
 * Borrow a string.
 *
 * The returned pointer is valid only until strres_release(), which must be
 * called exactly once for every hold -- including when this returns NULL, which
 * it does on a miss. Holding a string pins its whole section in the cache, so
 * hold briefly: two held sections with a one-slot cache will fail the second.
 */
typedef struct {
    void *section;      /* opaque; NULL when nothing is held */
} strres_hold_t;

const char *strres_hold(strres_id_t id, strres_hold_t *hold);
void strres_release(strres_hold_t *hold);

/*
 * Declared, deliberately never defined.
 *
 * It is only ever named inside the dead branch below, and the compiler drops
 * that branch before it emits a call -- so this resolves at link time despite
 * having no definition anywhere. It exists to carry the format attribute, which
 * is what does the checking. Never call it.
 */
extern void strres_check_format(const char *fmt, ...)
    __attribute__((format(printf, 1, 2)));

/*
 * Print with the arguments checked at compile time.
 *
 * The `if (0)` branch is never executed and never reaches the image: GCC folds
 * it away before optimisation, so at every -O level -- including -O0 -- the
 * text does not appear in the object file and the call does not appear in the
 * link. What survives is the diagnostic. The compiler still checks type and
 * arity against the English wording, so moving a string out of the binary costs
 * no -Wformat coverage:
 *
 *     STRRES_PRINTF(STR_GPIO_NO_PIN, "17");
 *     error: format '%d' expects argument of type 'int', but argument 2 has
 *            type 'char *'
 *
 * A translation is checked separately: strres_compile.py rejects a locale whose
 * conversion specifiers differ from the base, because only the base is visible
 * here.
 *
 * `id` must be a generated STR_* macro name, since STRRES_FMT_##id names the
 * text beside it. A statement form is required: the ternary expression form
 * trips -Wunused-value under -Werror.
 */
#define STRRES_PRINTF(id, ...)                                          \
    do {                                                                \
        if (0) strres_check_format(STRRES_FMT_##id, ##__VA_ARGS__);     \
        strres_printf((id), ##__VA_ARGS__);                             \
    } while (0)

#define STRRES_ERROR(id, ...)                                           \
    do {                                                                \
        if (0) strres_check_format(STRRES_FMT_##id, ##__VA_ARGS__);     \
        strres_error((id), ##__VA_ARGS__);                              \
    } while (0)

#ifdef __cplusplus
}
#endif

#endif /* STRRES_H */
